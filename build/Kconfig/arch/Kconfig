## build/Kconfig/arch/Kconfig
```kconfig
# Load Zephyr Arch Kconfig descriptions.
osource "/home/minhluu/zephyr_proj/zephyr/arch/rx/Kconfig"
osource "/home/minhluu/zephyr_proj/zephyr/arch/x86/Kconfig"
osource "/home/minhluu/zephyr_proj/zephyr/arch/xtensa/Kconfig"
osource "/home/minhluu/zephyr_proj/zephyr/arch/sparc/Kconfig"
osource "/home/minhluu/zephyr_proj/zephyr/arch/riscv/Kconfig"
osource "/home/minhluu/zephyr_proj/zephyr/arch/posix/Kconfig"
osource "/home/minhluu/zephyr_proj/zephyr/arch/mips/Kconfig"
osource "/home/minhluu/zephyr_proj/zephyr/arch/arm64/Kconfig"
osource "/home/minhluu/zephyr_proj/zephyr/arch/arm/Kconfig"
osource "/home/minhluu/zephyr_proj/zephyr/arch/arc/Kconfig"
```

## build/Kconfig/boards/Kconfig.defconfig
```kconfig
# Load Zephyr board defconfig descriptions.
osource "/home/minhluu/zephyr_proj/zephyr/boards/nordic/nrf52dk/Kconfig.defconfig"
```

## build/Kconfig/boards/Kconfig.sysbuild
```kconfig
# Load Sysbuild board Kconfig descriptions.
osource "/home/minhluu/zephyr_proj/zephyr/boards/nordic/nrf52dk/Kconfig.sysbuild"
```

## build/Kconfig/soc/Kconfig
```kconfig
# Load Zephyr SoC Kconfig descriptions.
osource "/home/minhluu/zephyr_proj/zephyr/soc/xlnx/zynqmp/Kconfig"
osource "/home/minhluu/zephyr_proj/zephyr/soc/xlnx/zynq7000/Kconfig"
osource "/home/minhluu/zephyr_proj/zephyr/soc/xlnx/versalnet/Kconfig"
osource "/home/minhluu/zephyr_proj/zephyr/soc/xlnx/versal2/Kconfig"
osource "/home/minhluu/zephyr_proj/zephyr/soc/xen/Kconfig"
osource "/home/minhluu/zephyr_proj/zephyr/soc/wch/ch32v/Kconfig"
osource "/home/minhluu/zephyr_proj/zephyr/soc/ti/simplelink/Kconfig"
osource "/home/minhluu/zephyr_proj/zephyr/soc/ti/mspm0/Kconfig"
osource "/home/minhluu/zephyr_proj/zephyr/soc/ti/lm3s6965/Kconfig"
osource "/home/minhluu/zephyr_proj/zephyr/soc/ti/k3/Kconfig"
osource "/home/minhluu/zephyr_proj/zephyr/soc/telink/tlsr/Kconfig"
osource "/home/minhluu/zephyr_proj/zephyr/soc/starfive/jh71xx/Kconfig"
osource "/home/minhluu/zephyr_proj/zephyr/soc/st/stm32/Kconfig"
osource "/home/minhluu/zephyr_proj/zephyr/soc/snps/qemu_arc/Kconfig"
osource "/home/minhluu/zephyr_proj/zephyr/soc/snps/nsim/arc_v/Kconfig"
osource "/home/minhluu/zephyr_proj/zephyr/soc/snps/nsim/arc_classic/Kconfig"
osource "/home/minhluu/zephyr_proj/zephyr/soc/snps/hsdk4xd/Kconfig"
osource "/home/minhluu/zephyr_proj/zephyr/soc/snps/hsdk/Kconfig"
osource "/home/minhluu/zephyr_proj/zephyr/soc/snps/emsk/Kconfig"
osource "/home/minhluu/zephyr_proj/zephyr/soc/snps/emsdp/Kconfig"
osource "/home/minhluu/zephyr_proj/zephyr/soc/snps/arc_iot/Kconfig"
osource "/home/minhluu/zephyr_proj/zephyr/soc/silabs/Kconfig"
osource "/home/minhluu/zephyr_proj/zephyr/soc/sifive/sifive_freedom/Kconfig"
osource "/home/minhluu/zephyr_proj/zephyr/soc/sensry/Kconfig"
osource "/home/minhluu/zephyr_proj/zephyr/soc/rockchip/Kconfig"
osource "/home/minhluu/zephyr_proj/zephyr/soc/renode/riscv_virtual/Kconfig"
osource "/home/minhluu/zephyr_proj/zephyr/soc/renode/cortex_r8_virtual/Kconfig"
osource "/home/minhluu/zephyr_proj/zephyr/soc/renesas/smartbond/Kconfig"
osource "/home/minhluu/zephyr_proj/zephyr/soc/renesas/rz/Kconfig"
osource "/home/minhluu/zephyr_proj/zephyr/soc/renesas/rx/Kconfig"
osource "/home/minhluu/zephyr_proj/zephyr/soc/renesas/rcar/Kconfig"
osource "/home/minhluu/zephyr_proj/zephyr/soc/renesas/ra/Kconfig"
osource "/home/minhluu/zephyr_proj/zephyr/soc/realtek/ec/Kconfig"
osource "/home/minhluu/zephyr_proj/zephyr/soc/raspberrypi/rpi_pico/Kconfig"
osource "/home/minhluu/zephyr_proj/zephyr/soc/quicklogic/eos_s3/Kconfig"
osource "/home/minhluu/zephyr_proj/zephyr/soc/qemu/virt_riscv/Kconfig"
osource "/home/minhluu/zephyr_proj/zephyr/soc/qemu/malta/Kconfig"
osource "/home/minhluu/zephyr_proj/zephyr/soc/openisa/rv32m1/Kconfig"
osource "/home/minhluu/zephyr_proj/zephyr/soc/openhwgroup/cva6/Kconfig"
osource "/home/minhluu/zephyr_proj/zephyr/soc/oct/osd32mp15x/Kconfig"
osource "/home/minhluu/zephyr_proj/zephyr/soc/nxp/s32/Kconfig"
osource "/home/minhluu/zephyr_proj/zephyr/soc/nxp/rw/Kconfig"
osource "/home/minhluu/zephyr_proj/zephyr/soc/nxp/mcx/Kconfig"
osource "/home/minhluu/zephyr_proj/zephyr/soc/nxp/lpc/Kconfig"
osource "/home/minhluu/zephyr_proj/zephyr/soc/nxp/layerscape/Kconfig"
osource "/home/minhluu/zephyr_proj/zephyr/soc/nxp/kinetis/Kconfig"
osource "/home/minhluu/zephyr_proj/zephyr/soc/nxp/imxrt/Kconfig"
osource "/home/minhluu/zephyr_proj/zephyr/soc/nxp/imx/Kconfig"
osource "/home/minhluu/zephyr_proj/zephyr/soc/nuvoton/numicro/Kconfig"
osource "/home/minhluu/zephyr_proj/zephyr/soc/nuvoton/numaker/Kconfig"
osource "/home/minhluu/zephyr_proj/zephyr/soc/nuvoton/npcx/Kconfig"
osource "/home/minhluu/zephyr_proj/zephyr/soc/nuvoton/npcm/Kconfig"
osource "/home/minhluu/zephyr_proj/zephyr/soc/nordic/Kconfig"
osource "/home/minhluu/zephyr_proj/zephyr/soc/neorv32/Kconfig"
osource "/home/minhluu/zephyr_proj/zephyr/soc/native/inf_clock/Kconfig"
osource "/home/minhluu/zephyr_proj/zephyr/soc/microchip/sam/Kconfig"
osource "/home/minhluu/zephyr_proj/zephyr/soc/microchip/miv/Kconfig"
osource "/home/minhluu/zephyr_proj/zephyr/soc/microchip/mec/Kconfig"
osource "/home/minhluu/zephyr_proj/zephyr/soc/mediatek/mt8xxx/Kconfig"
osource "/home/minhluu/zephyr_proj/zephyr/soc/lowrisc/opentitan/Kconfig"
osource "/home/minhluu/zephyr_proj/zephyr/soc/litex/litex_vexriscv/Kconfig"
osource "/home/minhluu/zephyr_proj/zephyr/soc/ite/ec/Kconfig"
osource "/home/minhluu/zephyr_proj/zephyr/soc/intel/raptor_lake/Kconfig"
osource "/home/minhluu/zephyr_proj/zephyr/soc/intel/lakemont/Kconfig"
osource "/home/minhluu/zephyr_proj/zephyr/soc/intel/intel_socfpga_std/Kconfig"
osource "/home/minhluu/zephyr_proj/zephyr/soc/intel/intel_socfpga/Kconfig"
osource "/home/minhluu/zephyr_proj/zephyr/soc/intel/intel_niosv/Kconfig"
osource "/home/minhluu/zephyr_proj/zephyr/soc/intel/intel_ish/Kconfig"
osource "/home/minhluu/zephyr_proj/zephyr/soc/intel/intel_adsp/Kconfig"
osource "/home/minhluu/zephyr_proj/zephyr/soc/intel/elkhart_lake/Kconfig"
osource "/home/minhluu/zephyr_proj/zephyr/soc/intel/atom/Kconfig"
osource "/home/minhluu/zephyr_proj/zephyr/soc/intel/apollo_lake/Kconfig"
osource "/home/minhluu/zephyr_proj/zephyr/soc/intel/alder_lake/Kconfig"
osource "/home/minhluu/zephyr_proj/zephyr/soc/infineon/cat3/Kconfig"
osource "/home/minhluu/zephyr_proj/zephyr/soc/infineon/cat1c/Kconfig"
osource "/home/minhluu/zephyr_proj/zephyr/soc/infineon/cat1b/Kconfig"
osource "/home/minhluu/zephyr_proj/zephyr/soc/infineon/cat1a/Kconfig"
osource "/home/minhluu/zephyr_proj/zephyr/soc/gd/gd32/Kconfig"
osource "/home/minhluu/zephyr_proj/zephyr/soc/gaisler/leon3/Kconfig"
osource "/home/minhluu/zephyr_proj/zephyr/soc/gaisler/gr716a/Kconfig"
osource "/home/minhluu/zephyr_proj/zephyr/soc/espressif/Kconfig"
osource "/home/minhluu/zephyr_proj/zephyr/soc/ene/kb1200/Kconfig"
osource "/home/minhluu/zephyr_proj/zephyr/soc/ene/kb106x/Kconfig"
osource "/home/minhluu/zephyr_proj/zephyr/soc/efinix/sapphire/Kconfig"
osource "/home/minhluu/zephyr_proj/zephyr/soc/cdns/xtensa_sample_controller/Kconfig"
osource "/home/minhluu/zephyr_proj/zephyr/soc/cdns/sample_controller32/Kconfig"
osource "/home/minhluu/zephyr_proj/zephyr/soc/cdns/dc233c/Kconfig"
osource "/home/minhluu/zephyr_proj/zephyr/soc/brcm/bcmvk/Kconfig"
osource "/home/minhluu/zephyr_proj/zephyr/soc/brcm/bcm2712/Kconfig"
osource "/home/minhluu/zephyr_proj/zephyr/soc/brcm/bcm2711/Kconfig"
osource "/home/minhluu/zephyr_proj/zephyr/soc/bflb/Kconfig"
osource "/home/minhluu/zephyr_proj/zephyr/soc/atmel/sam0/Kconfig"
osource "/home/minhluu/zephyr_proj/zephyr/soc/atmel/sam/Kconfig"
osource "/home/minhluu/zephyr_proj/zephyr/soc/aspeed/Kconfig"
osource "/home/minhluu/zephyr_proj/zephyr/soc/arm/Kconfig"
osource "/home/minhluu/zephyr_proj/zephyr/soc/arm/beetle/Kconfig"
osource "/home/minhluu/zephyr_proj/zephyr/soc/antmicro/myra/Kconfig"
osource "/home/minhluu/zephyr_proj/zephyr/soc/andestech/Kconfig"
osource "/home/minhluu/zephyr_proj/zephyr/soc/amd/acp_6_0/Kconfig"
osource "/home/minhluu/zephyr_proj/zephyr/soc/ambiq/Kconfig"
osource "/home/minhluu/zephyr_proj/zephyr/soc/aesc/Kconfig"
osource "/home/minhluu/zephyr_proj/zephyr/soc/adi/max32/Kconfig"
```
